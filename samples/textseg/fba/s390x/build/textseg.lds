/* s390x Stand-Alone Linker Script      
   Generated by ipldpp.py - DO NOT EDIT */

OUTPUT_FORMAT(elf64-s390)
OUTPUT_ARCH(s390:64-bit)
TARGET(elf64-s390)
ENTRY(_start)

MEMORY
{
    ELF2 (rwx) : ORIGIN = 0x2078, LENGTH = 0xFFDF88
}

PHDRS
{
    TEXT PT_LOAD    FLAGS ( 0x00000007 ) ;
}

SECTIONS
{
    .text 0x2078  :    
    {
        . = ALIGN(16) ;
        *(.text)
        . = ALIGN(16) ;
        *(.data)
        . = ALIGN(16) ;
        PROVIDE(_GOT_begin = .);
        *(.got)
        PROVIDE(_GOT_end = .);
        . = ALIGN(16) ;
        *(.shstrtab)
        . = ALIGN(16) ;
        *(.symtab)
        . = ALIGN(16) ;
        *(.strtab)
        . = ALIGN(16) ;
        *(.rela.text)
        . = ALIGN(16) ;
        *(.bss)
    } >ELF2  :TEXT

}

